## firmware/components/usb_device/Kconfig
```kconfig
menu "AirDAP USB device"

    config AIRDAP_DEBUG_SHELL
        bool "Enable the USB Vendor Bulk debug shell"
        default n
        select FREERTOS_GENERATE_RUN_TIME_STATS
        select FREERTOS_VTASKLIST_INCLUDE_COREID if !FREERTOS_SMP
        help
            Add a Vendor-specific Bulk interface for AirDAP firmware
            diagnostics. The shell provides detailed read-only system, heap,
            mode, OTA, target, and FreeRTOS task diagnostics, along with Wi-Fi
            credential management, BOOT_KEY simulation, and restart commands.
            Simulating BOOT_KEY can open BLE provisioning or clear network
            configuration and restart the device. The shell also mirrors ESP
            logs after the host starts a session. Enabling the shell collects
            FreeRTOS task run-time statistics and includes task core affinity.
            Set TinyUSB Vendor Interface Count to 2 when enabling this option.
            The checked-in sdkconfig.defaults profile sets the interface count
            and uses a 64-bit run-time counter for reproducible standard builds.

endmenu
```

## firmware/sdkconfig.defaults
```kconfig
CONFIG_IDF_TARGET="esp32s3"
CONFIG_BOOTLOADER_REGION_PROTECTION_ENABLE=y
CONFIG_BOOTLOADER_WDT_ENABLE=y
CONFIG_BOOTLOADER_WDT_TIME_MS=9000
CONFIG_BOOTLOADER_SKIP_VALIDATE_IN_DEEP_SLEEP=n
CONFIG_BOOTLOADER_SKIP_VALIDATE_ON_POWER_ON=n
CONFIG_BOOTLOADER_SKIP_VALIDATE_ALWAYS=n
CONFIG_BOOTLOADER_APP_ROLLBACK_ENABLE=y
CONFIG_COMPILER_OPTIMIZATION_SIZE=y
CONFIG_ESPTOOLPY_FLASHSIZE_8MB=y
CONFIG_PARTITION_TABLE_CUSTOM=y
CONFIG_PARTITION_TABLE_CUSTOM_FILENAME="partitions.csv"
CONFIG_ESP_CONSOLE_SECONDARY_NONE=y
# BLE provisioning starts from the default event loop; leave enough stack for
# the network provisioning manager and NimBLE initialization call chain.
CONFIG_ESP_SYSTEM_EVENT_TASK_STACK_SIZE=4096
CONFIG_TINYUSB_CDC_ENABLED=y
CONFIG_TINYUSB_CDC_COUNT=1
CONFIG_TINYUSB_CDC_RX_BUFSIZE=512
CONFIG_TINYUSB_CDC_TX_BUFSIZE=512
CONFIG_TINYUSB_CDC_EP_BUFSIZE=64
CONFIG_AIRDAP_DEBUG_SHELL=y
CONFIG_TINYUSB_VENDOR_COUNT=2
CONFIG_FREERTOS_GENERATE_RUN_TIME_STATS=y
CONFIG_FREERTOS_RUN_TIME_COUNTER_TYPE_U64=y
CONFIG_FREERTOS_RUN_TIME_STATS_USING_ESP_TIMER=y
CONFIG_FREERTOS_VTASKLIST_INCLUDE_COREID=y
CONFIG_TINYUSB_VENDOR_RX_BUFSIZE=512
CONFIG_TINYUSB_VENDOR_TX_BUFSIZE=512
CONFIG_TINYUSB_VENDOR_EPSIZE=64
CONFIG_ESP_PROTOCOMM_SUPPORT_SECURITY_VERSION_2=y
# mDNS 1.11.x internally compares the active interface with one alternate.
CONFIG_MDNS_MAX_INTERFACES=2
CONFIG_MDNS_MAX_SERVICES=1
CONFIG_MDNS_ENABLE_CONSOLE_CLI=n
CONFIG_MDNS_MULTIPLE_INSTANCE=n
CONFIG_MDNS_PREDEF_NETIF_STA=y
CONFIG_MDNS_PREDEF_NETIF_AP=n
CONFIG_BT_ENABLED=y
CONFIG_BT_NIMBLE_ENABLED=y
# Security 2 uses a 406-byte SRP request; MTU 517 provides a 514-byte ATT payload.
CONFIG_BT_NIMBLE_ATT_PREFERRED_MTU=517
CONFIG_NETWORK_PROV_NETWORK_TYPE_WIFI=y
CONFIG_NETWORK_PROV_BLE_SEC_CONN=y
CONFIG_NETWORK_PROV_AUTOSTOP_TIMEOUT=30
# CONFIG_ESP_WIFI_NVS_ENABLED is not set
CONFIG_ESP_TLS_PSK_VERIFICATION=y
CONFIG_MBEDTLS_SSL_PROTO_TLS1_3=y
# CONFIG_MBEDTLS_SSL_TLS1_3_KEXM_PSK is not set
# CONFIG_MBEDTLS_SSL_TLS1_3_KEXM_EPHEMERAL is not set
CONFIG_MBEDTLS_SSL_TLS1_3_KEXM_PSK_EPHEMERAL=y
# CONFIG_MBEDTLS_SSL_EARLY_DATA is not set
# CONFIG_MBEDTLS_SERVER_SSL_SESSION_TICKETS is not set
# CONFIG_ESP_TLS_SERVER_SESSION_TICKETS is not set
CONFIG_LOG_DEFAULT_LEVEL_INFO=y
CONFIG_LOG_MAXIMUM_EQUALS_DEFAULT=y
```
